## beehive-monitor-system/gateway/components/app_common/Kconfig
```kconfig
menu "Beehive Gateway"

config BEEHIVE_WIFI_SSID
    string "Wi-Fi SSID"
    default ""
    help
        Wi-Fi network name used by the gateway station interface.

config BEEHIVE_WIFI_PASSWORD
    string "Wi-Fi password"
    default ""
    help
        Wi-Fi password. It is never printed by the firmware.

config BEEHIVE_GATEWAY_ID
    string "Gateway ID"
    default "gw-001"
    help
        Gateway identifier used in MQTT topics and telemetry payloads.

config BEEHIVE_MQTT_URI
    string "MQTT broker URI"
    default "mqtt://120.27.235.176:1883"
    help
        MQTT broker URI, for example mqtt://120.27.235.176:1883 or mqtts://broker.example.com:8883.

config BEEHIVE_MQTT_USERNAME
    string "MQTT username"
    default ""
    help
        Optional MQTT username. It is never printed by the firmware.

config BEEHIVE_MQTT_PASSWORD
    string "MQTT password"
    default ""
    help
        Optional MQTT password. It is never printed by the firmware.

config BEEHIVE_MQTT_CLIENT_ID
    string "MQTT client ID"
    default "beehive_gw_001"
    help
        MQTT client identifier. It must be unique on the broker.

config BEEHIVE_MQTT_TOPIC_PREFIX
    string "MQTT topic prefix"
    default "beehive/v1"
    help
        Root topic prefix used for telemetry and gateway status topics.

config BEEHIVE_MQTT_TOPIC_MODE
    string "MQTT topic mode"
    default "hierarchical"
    help
        Use hierarchical for the normal topic tree or bemfa for flat alphanumeric topics.

config BEEHIVE_MQTT_TELEMETRY_TOPIC
    string "Flat telemetry topic"
    default ""
    help
        Complete alphanumeric telemetry topic used when topic mode is bemfa.

config BEEHIVE_MQTT_STATUS_TOPIC
    string "Flat status topic"
    default ""
    help
        Complete alphanumeric gateway status topic used when topic mode is bemfa.

endmenu
```

## beehive-monitor-system/gateway/sdkconfig.defaults
```kconfig
CONFIG_IDF_TARGET="esp32s3"
CONFIG_ESPTOOLPY_FLASHSIZE_16MB=y
CONFIG_ESPTOOLPY_FLASHSIZE="16MB"
CONFIG_SPIRAM=y
CONFIG_SPIRAM_MODE_OCT=y
CONFIG_SPIRAM_TYPE_AUTO=y
CONFIG_SPIRAM_SPEED_80M=y
CONFIG_SPIRAM_USE_MALLOC=y
CONFIG_SPIRAM_MEMTEST=y
CONFIG_BEEHIVE_WIFI_SSID=""
CONFIG_BEEHIVE_WIFI_PASSWORD=""
CONFIG_BEEHIVE_GATEWAY_ID="gw-001"
CONFIG_BEEHIVE_MQTT_URI="mqtt://120.27.235.176:1883"
CONFIG_BEEHIVE_MQTT_USERNAME=""
CONFIG_BEEHIVE_MQTT_PASSWORD=""
CONFIG_BEEHIVE_MQTT_CLIENT_ID="beehive_gw_001"
CONFIG_BEEHIVE_MQTT_TOPIC_PREFIX="beehive/v1"
CONFIG_BEEHIVE_MQTT_TOPIC_MODE="hierarchical"
CONFIG_BEEHIVE_MQTT_TELEMETRY_TOPIC=""
CONFIG_BEEHIVE_MQTT_STATUS_TOPIC=""
```
